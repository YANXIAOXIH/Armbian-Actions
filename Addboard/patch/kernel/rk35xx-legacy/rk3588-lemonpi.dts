// SPDX-License-Identifier: (GPL-2.0+ OR MIT)
/*
 * Copyright (c) 2021 Rockchip Electronics Co., Ltd.
 * Device Tree Source for LemonPi board on Rockchip RK3588 SoC.
 * Kernel Version Target: 6.1
 *
 */

/dts-v1/;

#include <dt-bindings/usb/pd.h>
#include <dt-bindings/gpio/gpio.h>
#include <dt-bindings/input/linux-event-codes.h>
#include <dt-bindings/display/rockchip_vop.h>
#include "rk3588.dtsi"
#include "rk3588-linux.dtsi"

/ {
	model = "LemonPi";
	compatible = "rockchip,rk3588-lemonpi", "rockchip,rk3588";

	/* 256MB CMA memory for multimedia */
	reserved-memory {
		#address-cells = <2>;
		#size-cells = <2>;
		ranges;

		cma {
			compatible = "shared-dma-pool";
			reusable;
			reg = <0x0 (256 * 0x100000) 0x0 (256 * 0x100000)>;
			linux,cma-default;
		};
	};

	/* Kernel boot arguments */
	chosen: chosen {
		bootargs = "earlycon=uart8250,mmio32,0xfeb50000 console=ttyFIQ0 irqchip.gicv3_pseudo_nmi=0 rcupdate.rcu_expedited=1 rcu_nocbs=all";
	};

	/* ADC buttons */
	adc_keys: adc-keys {
		compatible = "adc-keys";
		io-channels = <&saradc 1>;
		io-channel-names = "buttons";
		keyup-threshold-microvolt = <1800000>;
		poll-interval = <100>;

		power {
			label = "power";
			linux,code = <KEY_POWER>;
			press-threshold-microvolt = <1750>;
		};
	};

	/* On-board LEDs */
	leds: leds {
		status = "okay";
		compatible = "gpio-leds";

		sys_led: sys-led {
			label = "sys_led";
			linux,default-trigger = "heartbeat";
			default-state = "on";
			gpios = <&gpio0 RK_PD3 GPIO_ACTIVE_LOW>;
			pinctrl-names = "default";
			pinctrl-0 = <&sys_led_pin>;
		};

		abc_led: abc-led {
			label = "abc_led";
			linux,default-trigger = "heartbeat";
			default-state = "on";
			gpios = <&gpio6 0 GPIO_ACTIVE_HIGH>;
		};

		def_led: def-led {
			label = "def_led";
			linux,default-trigger = "heartbeat";
			default-state = "on";
			gpios = <&gpio7 2 GPIO_ACTIVE_HIGH>;
		};
	};

	/* 12V DC input */
	vcc12v_dcin: vcc12v-dcin {
		compatible = "regulator-fixed";
		regulator-always-on;
		regulator-boot-on;
		regulator-min-microvolt = <12000000>;
		regulator-max-microvolt = <12000000>;
		regulator-name = "vcc12v_dcin";
	};

	/* 5V system supply */
	vcc5v0_sys: vcc5v0-sys {
		compatible = "regulator-fixed";
		regulator-name = "vcc5v0_sys";
		regulator-always-on;
		regulator-boot-on;
		regulator-min-microvolt = <5000000>;
		regulator-max-microvolt = <5000000>;
		vin-supply = <&vcc12v_dcin>;
	};

	/* 3.3V system supply */
	vcc3v3_sys: vcc3v3-sys {
		compatible = "regulator-fixed";
		regulator-name = "vcc3v3_sys";
		regulator-always-on;
		regulator-boot-on;
		regulator-min-microvolt = <3300000>;
		regulator-max-microvolt = <3300000>;
		vin-supply = <&vcc12v_dcin>;
	};

	/* 5V peripheral supply */
	vcc_5v0: vcc-5v0 {
		compatible = "regulator-fixed";
		regulator-name = "vcc_5v0";
		regulator-always-on;
		regulator-boot-on;
		regulator-min-microvolt = <5000000>;
		regulator-max-microvolt = <5000000>;
		vin-supply = <&vcc5v0_sys>;
	};

	/* 5V USB supply */
	vcc5v0_usb: vcc5v0-usb {
		compatible = "regulator-fixed";
		regulator-name = "vcc_5v0";
		regulator-always-on;
		regulator-boot-on;
		regulator-min-microvolt = <5000000>;
		regulator-max-microvolt = <5000000>;
		vin-supply = <&vcc5v0_sys>;
	};

	/* 1.8V Combo PHY analog supply */
	combophy_avdd1v8: combophy-avdd1v8 {
		compatible = "regulator-fixed";
		regulator-name = "combophy_avdd1v8";
		regulator-boot-on;
		regulator-min-microvolt = <1800000>;
		regulator-max-microvolt = <1800000>;
		vin-supply = <&avcc_1v8_s0>;
	};

	/* 1.1V NLDO supply, on in suspend */
	vcc_1v1_nldo_s3: vcc-1v1-nldo-s3 {
		compatible = "regulator-fixed";
		regulator-name = "vcc_1v1_nldo_s3";
		regulator-always-on;
		regulator-boot-on;
		regulator-min-microvolt = <1100000>;
		regulator-max-microvolt = <1100000>;
		vin-supply = <&vcc5v0_sys>;
	};

	/* 3.3V supply, on when active */
	vcc_3v3_s0: vcc-3v3-s0 {
		compatible = "regulator-fixed";
		regulator-name = "vcc_3v3_s0";
		regulator-always-on;
		regulator-boot-on;
		regulator-min-microvolt = <3300000>;
		regulator-max-microvolt = <3300000>;
		vin-supply = <&vcc_3v3_s3>;
	};

	/* 3.3V SD card supply, on in suspend */
	vcc_3v3_sd_s3: vcc-3v3-sd-s3 {
		compatible = "regulator-fixed";
		regulator-name = "vcc_3v3_sd_s3";
		regulator-always-on;
		regulator-boot-on;
		regulator-min-microvolt = <3300000>;
		regulator-max-microvolt = <3300000>;
		vin-supply = <&vcc_3v3_s3>;
	};

	/* USB Type-C VBUS switch */
	vbus_typec: vbus-typec {
		compatible = "regulator-fixed";
		regulator-name = "vbus_typec";
		regulator-min-microvolt = <5000000>;
		regulator-max-microvolt = <5000000>;
		enable-active-high;
		gpio = <&gpio2 RK_PB5 GPIO_ACTIVE_HIGH>;
		vin-supply = <&vcc5v0_usb>;
		pinctrl-names = "default";
		pinctrl-0 = <&typec_vbus_en>;
	};

	/* MIPI DSI0 power */
	mipi_dsi0_power: mipi-dsi0-power-regulator {
		compatible = "regulator-fixed";
		regulator-name = "mipi_dsi0_power";
		gpio = <&gpio1 RK_PD2 GPIO_ACTIVE_HIGH>;
		enable-active-high;
		regulator-boot-on;
		regulator-always-on;
	};

	/* MIPI DSI1 power */
	mipi_dsi1_power: mipi-dsi1-power-regulator {
		compatible = "regulator-fixed";
		regulator-name = "mipi_dsi1_power";
		gpio = <&gpio2 RK_PB4 GPIO_ACTIVE_HIGH>;
		enable-active-high;
		regulator-boot-on;
		regulator-always-on;
	};

	/* MIPI DP1/eDP power */
	mipi_dp1_power: mipi-edp-power-regulator {
		compatible = "regulator-fixed";
		regulator-name = "mipi_dp1_power";
		gpio = <&gpio0 RK_PA0 GPIO_ACTIVE_HIGH>;
		enable-active-high;
		regulator-boot-on;
		regulator-always-on;
	};

	/* HDMI1 audio output */
	hdmi1_sound: hdmi1-sound {
		status = "okay";
		compatible = "rockchip,hdmi";
		rockchip,mclk-fs = <128>;
		rockchip,card-name = "rockchip-hdmi1";
		rockchip,cpu = <&i2s6_8ch>;
		rockchip,codec = <&hdmi1>;
		rockchip,jack-det;
	};

	/* HDMI audio input */
	hdmiin_sound: hdmiin-sound {
		compatible = "rockchip,hdmi";
		rockchip,mclk-fs = <128>;
		rockchip,format = "i2s";
		rockchip,bitclock-master = <&hdmirx_ctrler>;
		rockchip,frame-master = <&hdmirx_ctrler>;
		rockchip,card-name = "rockchip-hdmiin";
		rockchip,cpu = <&i2s7_8ch>;
		rockchip,codec = <&hdmirx_ctrler 0>;
		rockchip,jack-det;
	};

	/* DisplayPort 0 audio output */
	dp0_sound: dp0-sound {
		status = "okay";
		compatible = "rockchip,hdmi";
		rockchip,card-name = "rockchip-dp0";
		rockchip,mclk-fs = <512>;
		rockchip,cpu = <&spdif_tx2>;
		rockchip,codec = <&dp0 1>;
		rockchip,jack-det;
	};

	/* ES8388 audio card */
	es8388_sound: es8388-sound {
		status = "okay";
		compatible = "rockchip,multicodecs-card";
		rockchip,card-name = "rockchip-es8388";
		hp-det-gpio = <&gpio1 RK_PD3 GPIO_ACTIVE_HIGH>;
		hp-con-gpio = <&gpio1 RK_PB5 GPIO_ACTIVE_HIGH>;
		io-channels = <&saradc 4>;
		io-channel-names = "adc-detect";
		keyup-threshold-microvolt = <1800000>;
		poll-interval = <100>;
		rockchip,format = "i2s";
		rockchip,mclk-fs = <256>;
		rockchip,cpu = <&i2s0_8ch>;
		rockchip,codec = <&es8388>;
		rockchip,audio-routing =
			"Headphone", "LOUT1",
			"Headphone", "ROUT1",
			"Headphone", "Headphone Power",
			"Headphone", "Headphone Power",
			"LINPUT1", "Main Mic",
			"LINPUT2", "Main Mic",
			"RINPUT1", "Headset Mic",
			"RINPUT2", "Headset Mic";
		pinctrl-names = "default";
		pinctrl-0 = <&hp_det>;
		play-pause-key {
			label = "playpause";
			linux,code = <KEY_PLAYPAUSE>;
			press-threshold-microvolt = <2000>;
		};

		previous-song-key {
			label = "previoussong";
			linux,code = <KEY_PREVIOUSSONG>;
			press-threshold-microvolt = <145000>;
		};

		next-song-key {
			label = "nextsong";
			linux,code = <KEY_NEXTSONG>;
			press-threshold-microvolt = <290000>;
		};
	};

	/* PWM cooling fan */
	fan: pwm-fan {
		compatible = "pwm-fan";
		#cooling-cells = <2>;
		pwms = <&pwm4 0 5000 0>;
		cooling-levels = <0 100 150 200 255>;
		rockchip,temp-trips = <
			50000	1
			55000	2
			60000	3
			65000	4
		>;
	};

	/* Test power node */
	test-power {
		status = "okay";
	};
};

/* Enable AV1 decoder */
&av1d {
	status = "okay";
};

/* Enable AV1 decoder MMU */
&av1d_mmu {
	status = "okay";
};

/* Enable SPDIF TX2 */
&spdif_tx2 {
	status = "okay";
};

/* Enable I2S5 */
&i2s5_8ch {
	status = "okay";
};

/* Enable I2S6 */
&i2s6_8ch {
	status = "okay";
};

/* CPU little core supplies */
&cpu_l0 {
	cpu-supply = <&vdd_cpu_lit_s0>;
	mem-supply = <&vdd_cpu_lit_mem_s0>;
};

/* CPU big core cluster 0 supplies */
&cpu_b0 {
	cpu-supply = <&vdd_cpu_big0_s0>;
	mem-supply = <&vdd_cpu_big0_mem_s0>;
};

/* CPU big core cluster 1 supplies */
&cpu_b2 {
	cpu-supply = <&vdd_cpu_big1_s0>;
	mem-supply = <&vdd_cpu_big1_mem_s0>;
};

/* Enable GPU */
&gpu {
	mali-supply = <&vdd_gpu_s0>;
	mem-supply = <&vdd_gpu_mem_s0>;
	upthreshold = <60>;
	downdifferential = <30>;
	status = "okay";
};

/* Enable DFI */
&dfi {
	status = "okay";
};

/* Enable DMC */
&dmc {
	status = "okay";
	center-supply = <&vdd_ddr_s0>;
	mem-supply = <&vdd_log_s0>;
};

/* Enable I2C4 */
&i2c4 {
	status = "okay";
	pinctrl-names = "default";
	pinctrl-0 = <&i2c4m3_xfer>;
};

/* Enable I2C3 */
&i2c3 {
	status = "okay";
	pinctrl-names = "default";
	pinctrl-0 = <&i2c3m0_xfer>;
};

/* System suspend config */
&rockchip_suspend {
	status = "okay";
	rockchip,sleep-debug-en = <1>;
	rockchip,sleep-mode-config = <
		(0
		| RKPM_SLP_ARMOFF_DDRPD
		| RKPM_SLP_PMU_PMUALIVE_32K
		| RKPM_SLP_PMU_DIS_OSC
		| RKPM_SLP_32K_EXT
		)
	>;
	rockchip,wakeup-config = <
		(0
		| RKPM_GPIO_WKUP_EN
		| RKPM_CPU0_WKUP_EN
		)
	>;
};

/* I2C5 Bus & GPIO Expander */
&i2c5 {
	pinctrl-names = "default";
	pinctrl-0 = <&i2c5m2_xfer>;
	status = "okay";

	gpio6: gpio-expander@21 {
		compatible = "nxp,pca9535";
		status = "okay";
		reg = <0x21>;
		gpio-controller;
		#gpio-cells = <2>;
		pinctrl-names = "default";
		pinctrl-0 = <&pinctrl_pca9535_1>;
		interrupt-parent = <&gpio2>;
		interrupts = <RK_PC4 IRQ_TYPE_LEVEL_LOW>;
		interrupt-controller;
		#interrupt-cells = <2>;
	};
};

/* I2C6 Bus & GPIO Expander */
&i2c6 {
	status = "okay";
	pinctrl-names = "default";
	pinctrl-0 = <&i2c6m0_xfer>;

	/* PCA9535 GPIO expander */
	gpio7: gpio-expander@21 {
		compatible = "nxp,pca9535";
		status = "okay";
		reg = <0x21>;
		gpio-controller;
		#gpio-cells = <2>;
		pinctrl-names = "default";
		pinctrl-0 = <&pinctrl_pca9535_2>;
		interrupt-parent = <&gpio2>;
		interrupts = <RK_PC5 IRQ_TYPE_LEVEL_LOW>;
		interrupt-controller;
		#interrupt-cells = <2>;
	};
};

/* I2C0 Bus & Devices */
&i2c0 {
	pinctrl-names = "default";
	pinctrl-0 = <&i2c0m2_xfer>;
	status = "okay";

	/* HYM8563 RTC */
	hym8563: hym8563@51 {
		compatible = "haoyu,hym8563";
		reg = <0x51>;
		#clock-cells = <0>;
		clock-frequency = <32768>;
		clock-output-names = "hym8563";
		pinctrl-names = "default";
		pinctrl-0 = <&hym8563_int>;
		interrupt-parent = <&gpio0>;
		interrupts = <RK_PB0 IRQ_TYPE_LEVEL_LOW>;
		wakeup-source;
	};

	/* PMIC for big core 0 */
	vdd_cpu_big0_s0: vdd_cpu_big0_mem_s0: rk8602@42 {
		compatible = "rockchip,rk8602";
		reg = <0x42>;
		vin-supply = <&vcc5v0_sys>;
		regulator-compatible = "rk860x-reg";
		regulator-name = "vdd_cpu_big0_s0";
		regulator-min-microvolt = <550000>;
		regulator-max-microvolt = <1050000>;
		regulator-ramp-delay = <2300>;
		rockchip,suspend-voltage-selector = <1>;
		regulator-boot-on;
		regulator-always-on;
		regulator-state-mem {
			regulator-off-in-suspend;
		};
	};

	/* PMIC for big core 1 */
	vdd_cpu_big1_s0: vdd_cpu_big1_mem_s0: rk8603@43 {
		compatible = "rockchip,rk8603";
		reg = <0x43>;
		vin-supply = <&vcc5v0_sys>;
		regulator-compatible = "rk860x-reg";
		regulator-name = "vdd_cpu_big1_s0";
		regulator-min-microvolt = <550000>;
		regulator-max-microvolt = <1050000>;
		regulator-ramp-delay = <2300>;
		rockchip,suspend-voltage-selector = <1>;
		regulator-boot-on;
		regulator-always-on;
		regulator-state-mem {
			regulator-off-in-suspend;
		};
	};
};

/* I2C1 Bus & Devices */
&i2c1 {
	pinctrl-names = "default";
	pinctrl-0 = <&i2c1m2_xfer>;
	status = "okay";

	/* PMIC for NPU */
	vdd_npu_s0: vdd_npu_mem_s0: rk8602@42 {
		compatible = "rockchip,rk8602";
		reg = <0x42>;
		vin-supply = <&vcc5v0_sys>;
		regulator-compatible = "rk860x-reg";
		regulator-name = "vdd_npu_s0";
		regulator-min-microvolt = <550000>;
		regulator-max-microvolt = <950000>;
		regulator-ramp-delay = <2300>;
		rockchip,suspend-voltage-selector = <1>;
		regulator-boot-on;
		regulator-always-on;
		regulator-state-mem {
			regulator-off-in-suspend;
		};
	};

	/* FUSB302 Type-C Controller */
	usbc0: fusb302@22 {
		compatible = "fcs,fusb302";
		reg = <0x22>;
		interrupt-parent = <&gpio0>;
		interrupts = <RK_PC4 IRQ_TYPE_LEVEL_LOW>;
		pinctrl-names = "default";
		pinctrl-0 = <&fusb302_int>;
		vbus-supply = <&vbus_typec>;
		status = "okay";

		ports {
			#address-cells = <1>;
			#size-cells = <0>;

			port@0 {
				reg = <0>;
				usbc0_role_sw: endpoint@0 {
					remote-endpoint = <&dwc3_0_role_switch>;
				};
			};
		};

		/* USB-C connector properties */
		usb_con: connector {
			compatible = "usb-c-connector";
			label = "USB-C";
			data-role = "dual";
			power-role = "dual";
			try-power-role = "sink";
			op-sink-microwatt = <1000000>;
			sink-pdos =
				<PDO_FIXED(5000, 1000, PDO_FIXED_USB_COMM)>;
			source-pdos =
				<PDO_FIXED(5000, 3000, PDO_FIXED_USB_COMM)>;

			altmodes {
				#address-cells = <1>;
				#size-cells = <0>;

				altmode@0 {
					reg = <0>;
					svid = <0xff01>;
					vdo = <0xffffffff>;
				};
			};

			ports {
				#address-cells = <1>;
				#size-cells = <0>;

				port@0 {
					reg = <0>;
					usbc0_orien_sw: endpoint {
						remote-endpoint = <&usbdp_phy0_orientation_switch>;
					};
				};

				port@1 {
					reg = <1>;
					dp_altmode_mux: endpoint {
						remote-endpoint = <&usbdp_phy0_dp_altmode_mux>;
					};
				};
			};
		};
	};
};

/* SPI2 Bus & Main PMIC */
&spi2 {
	status = "okay";
	assigned-clocks = <&cru CLK_SPI2>;
	assigned-clock-rates = <200000000>;
	pinctrl-names = "default";
	pinctrl-0 = <&spi2m2_cs0 &spi2m2_pins>;
	num-cs = <1>;

	/* RK806 PMIC */
	rk806single@0 {
		compatible = "rockchip,rk806";
		spi-max-frequency = <1000000>;
		reg = <0x0>;

		interrupt-parent = <&gpio0>;
		interrupts = <RK_PA7 IRQ_TYPE_LEVEL_LOW>;

		pinctrl-names = "default", "pmic-power-off";
		pinctrl-0 = <&pmic_pins>, <&rk806_dvs1_null>, <&rk806_dvs2_null>, <&rk806_dvs3_null>;
		pinctrl-1 = <&rk806_dvs1_pwrdn>;

		low_voltage_threshold = <3000>;
		shutdown_voltage_threshold = <2700>;
		shutdown_temperture_threshold = <160>;
		hotdie_temperture_threshold = <115>;
		pmic-reset-func = <1>;

		vcc1-supply = <&vcc5v0_sys>;
		vcc2-supply = <&vcc5v0_sys>;
		vcc3-supply = <&vcc5v0_sys>;
		vcc4-supply = <&vcc5v0_sys>;
		vcc5-supply = <&vcc5v0_sys>;
		vcc6-supply = <&vcc5v0_sys>;
		vcc7-supply = <&vcc5v0_sys>;
		vcc8-supply = <&vcc5v0_sys>;
		vcc9-supply = <&vcc5v0_sys>;
		vcc10-supply = <&vcc5v0_sys>;
		vcc11-supply = <&vcc_2v0_pldo_s3>;
		vcc12-supply = <&vcc5v0_sys>;
		vcc13-supply = <&vcc_1v1_nldo_s3>;
		vcc14-supply = <&vcc_1v1_nldo_s3>;
		vcca-supply = <&vcc5v0_sys>;

		pwrkey {
			status = "okay";
		};

		/* PMIC internal pin control */
		pinctrl_rk806: pinctrl_rk806 {
			gpio-controller;
			#gpio-cells = <2>;

			rk806_dvs1_null: rk806_dvs1_null {
				pins = "gpio_pwrctrl2";
				function = "pin_fun0";
			};

			rk806_dvs1_slp: rk806_dvs1_slp {
				pins = "gpio_pwrctrl1";
				function = "pin_fun1";
			};

			rk806_dvs1_pwrdn: rk806_dvs1_pwrdn {
				pins = "gpio_pwrctrl1";
				function = "pin_fun2";
			};

			rk806_dvs1_rst: rk806_dvs1_rst {
				pins = "gpio_pwrctrl1";
				function = "pin_fun3";
			};

			rk806_dvs2_null: rk806_dvs2_null {
				pins = "gpio_pwrctrl2";
				function = "pin_fun0";
			};

			rk806_dvs2_slp: rk806_dvs2_slp {
				pins = "gpio_pwrctrl2";
				function = "pin_fun1";
			};

			rk806_dvs2_pwrdn: rk806_dvs2_pwrdn {
				pins = "gpio_pwrctrl2";
				function = "pin_fun2";
			};

			rk806_dvs2_rst: rk806_dvs2_rst {
				pins = "gpio_pwrctrl2";
				function = "pin_fun3";
			};

			rk806_dvs2_dvs: rk806_dvs2_dvs {
				pins = "gpio_pwrctrl2";
				function = "pin_fun4";
			};

			rk806_dvs2_gpio: rk806_dvs2_gpio {
				pins = "gpio_pwrctrl2";
				function = "pin_fun5";
			};

			rk806_dvs3_null: rk806_dvs3_null {
				pins = "gpio_pwrctrl3";
				function = "pin_fun0";
			};

			rk806_dvs3_slp: rk806_dvs3_slp {
				pins = "gpio_pwrctrl3";
				function = "pin_fun1";
			};

			rk806_dvs3_pwrdn: rk806_dvs3_pwrdn {
				pins = "gpio_pwrctrl3";
				function = "pin_fun2";
			};

			rk806_dvs3_rst: rk806_dvs3_rst {
				pins = "gpio_pwrctrl3";
				function = "pin_fun3";
			};

			rk806_dvs3_dvs: rk806_dvs3_dvs {
				pins = "gpio_pwrctrl3";
				function = "pin_fun4";
			};

			rk806_dvs3_gpio: rk806_dvs3_gpio {
				pins = "gpio_pwrctrl3";
				function = "pin_fun5";
			};
		};

		/* PMIC Regulators */
		regulators {

			/* GPU core supply */
			vdd_gpu_s0: vdd_gpu_mem_s0: DCDC_REG1 {
				regulator-always-on;
				regulator-boot-on;
				regulator-min-microvolt = <550000>;
				regulator-max-microvolt = <950000>;
				regulator-ramp-delay = <12500>;
				regulator-name = "vdd_gpu_s0";
				regulator-enable-ramp-delay = <400>;
				regulator-state-mem { regulator-off-in-suspend; };
			};

			/* CPU little core supply */
			vdd_cpu_lit_s0: vdd_cpu_lit_mem_s0: DCDC_REG2 {
				regulator-always-on;
				regulator-boot-on;
				regulator-min-microvolt = <550000>;
				regulator-max-microvolt = <950000>;
				regulator-ramp-delay = <12500>;
				regulator-name = "vdd_cpu_lit_s0";
				regulator-state-mem { regulator-off-in-suspend; };
			};

			/* SoC logic supply */
			vdd_log_s0: DCDC_REG3 {
				regulator-always-on;
				regulator-boot-on;
				regulator-min-microvolt = <675000>;
				regulator-max-microvolt = <800000>;
				regulator-ramp-delay = <12500>;
				regulator-name = "vdd_log_s0";
				regulator-state-mem { regulator-off-in-suspend; };
			};

			/* Video encoder supply */
			vdd_vdenc_s0: vdd_vdenc_mem_s0: DCDC_REG4 {
				regulator-always-on;
				regulator-boot-on;
				regulator-min-microvolt = <550000>;
				regulator-max-microvolt = <950000>;
				regulator-init-microvolt = <750000>;
				regulator-ramp-delay = <12500>;
				regulator-name = "vdd_vdenc_s0";
				regulator-state-mem { regulator-off-in-suspend; };
			};

			/* DDR memory core supply */
			vdd_ddr_s0: DCDC_REG5 {
				regulator-always-on;
				regulator-boot-on;
				regulator-min-microvolt = <675000>;
				regulator-max-microvolt = <900000>;
				regulator-ramp-delay = <12500>;
				regulator-name = "vdd_ddr_s0";
				regulator-state-mem { regulator-off-in-suspend; };
			};

			/* DDR VDD2 supply, on in suspend */
			vdd2_ddr_s3: DCDC_REG6 {
				regulator-always-on;
				regulator-boot-on;
				regulator-name = "vdd2_ddr_s3";
				regulator-state-mem { regulator-on-in-suspend; };
			};

			/* 2.0V PLDO supply, on in suspend */
			vcc_2v0_pldo_s3: DCDC_REG7 {
				regulator-always-on;
				regulator-boot-on;
				regulator-min-microvolt = <2000000>;
				regulator-max-microvolt = <2000000>;
				regulator-name = "vdd_2v0_pldo_s3";
				regulator-state-mem {
					regulator-on-in-suspend;
					regulator-suspend-microvolt = <2000000>;
				};
			};

			/* 3.3V supply, on in suspend */
			vcc_3v3_s3: DCDC_REG8 {
				regulator-always-on;
				regulator-boot-on;
				regulator-min-microvolt = <3300000>;
				regulator-max-microvolt = <3300000>;
				regulator-name = "vcc_3v3_s3";
				regulator-state-mem { regulator-on-in-suspend; };
			};

			/* DDR VDDQ supply */
			vddq_ddr_s0: DCDC_REG9 {
				regulator-always-on;
				regulator-boot-on;
				regulator-name = "vddq_ddr_s0";
				regulator-state-mem { regulator-off-in-suspend; };
			};

			/* 1.8V supply, on in suspend */
			vcc_1v8_s3: DCDC_REG10 {
				regulator-always-on;
				regulator-boot-on;
				regulator-min-microvolt = <1800000>;
				regulator-max-microvolt = <1800000>;
				regulator-name = "vcc_1v8_s3";
				regulator-state-mem {
					regulator-on-in-suspend;
					regulator-suspend-microvolt = <1800000>;
				};
			};

			/* 1.8V analog supply */
			avcc_1v8_s0: PLDO_REG1 {
				regulator-always-on;
				regulator-boot-on;
				regulator-min-microvolt = <1800000>;
				regulator-max-microvolt = <1800000>;
				regulator-name = "avcc_1v8_s0";
				regulator-state-mem { regulator-on-in-suspend; };
			};

			/* 1.8V digital supply */
			vcc_1v8_s0: PLDO_REG2 {
				regulator-always-on;
				regulator-boot-on;
				regulator-min-microvolt = <1800000>;
				regulator-max-microvolt = <1800000>;
				regulator-name = "vcc_1v8_s0";
				regulator-state-mem { regulator-off-in-suspend; };
			};

			/* 1.2V analog supply */
			avdd_1v2_s0: PLDO_REG3 {
				regulator-always-on;
				regulator-boot-on;
				regulator-min-microvolt = <1200000>;
				regulator-max-microvolt = <1200000>;
				regulator-name = "avdd_1v2_s0";
				regulator-state-mem { regulator-off-in-suspend; };
			};

			/* 3.3V analog supply */
			avcc_3v3_s0: PLDO_REG4 {
				regulator-always-on;
				regulator-boot-on;
				regulator-min-microvolt = <3300000>;
				regulator-max-microvolt = <3300000>;
				regulator-name = "avcc_3v3_s0";
				regulator-state-mem { regulator-off-in-suspend; };
			};

			/* SD card IO supply */
			vccio_sd_s0: PLDO_REG5 {
				regulator-always-on;
				regulator-boot-on;
				regulator-min-microvolt = <1800000>;
				regulator-max-microvolt = <3300000>;
				regulator-name = "vccio_sd_s0";
				regulator-state-mem { regulator-off-in-suspend; };
			};

			/* PLDO6 supply, on in suspend */
			pldo6_s3: PLDO_REG6 {
				regulator-always-on;
				regulator-boot-on;
				regulator-min-microvolt = <1800000>;
				regulator-max-microvolt = <1800000>;
				regulator-name = "pldo6_s3";
				regulator-state-mem {
					regulator-on-in-suspend;
					regulator-suspend-microvolt = <1800000>;
				};
			};

			/* 0.75V supply, on in suspend */
			vdd_0v75_s3: NLDO_REG1 {
				regulator-always-on;
				regulator-boot-on;
				regulator-min-microvolt = <750000>;
				regulator-max-microvolt = <750000>;
				regulator-name = "vdd_0v75_s3";
				regulator-state-mem {
					regulator-on-in-suspend;
					regulator-suspend-microvolt = <750000>;
				};
			};

			/* DDR PLL analog supply */
			avdd_ddr_pll_s0: NLDO_REG2 {
				regulator-always-on;
				regulator-boot-on;
				regulator-min-microvolt = <850000>;
				regulator-max-microvolt = <850000>;
				regulator-name = "avdd_ddr_pll_s0";
				regulator-state-mem { regulator-off-in-suspend; };
			};

			/* 0.75V analog supply (at 0.8375V) */
			avdd_0v75_s0: NLDO_REG3 {
				regulator-always-on;
				regulator-boot-on;
				regulator-min-microvolt = <837500>;
				regulator-max-microvolt = <837500>;
				regulator-name = "avdd_0v75_s0";
				regulator-state-mem {
					regulator-off-in-suspend;
				};
			};

			/* 0.85V analog supply */
			avdd_0v85_s0: NLDO_REG4 {
				regulator-always-on;
				regulator-boot-on;
				regulator-min-microvolt = <850000>;
				regulator-max-microvolt = <850000>;
				regulator-name = "avdd_0v85_s0";
				regulator-state-mem {
					regulator-off-in-suspend;
				};
			};

			/* 0.75V digital supply */
			vdd_0v75_s0: NLDO_REG5 {
				regulator-always-on;
				regulator-boot-on;
				regulator-min-microvolt = <750000>;
				regulator-max-microvolt = <750000>;
				regulator-name = "vdd_0v75_s0";
				regulator-state-mem {
					regulator-off-in-suspend;
				};
			};
		};
	};
};

/* I2C7 Bus & Audio Codec */
&i2c7 {
	pinctrl-names = "default";
	pinctrl-0 = <&i2c7m0_xfer>;
	status = "okay";

	/* ES8388 audio codec */
	es8388: es8388@11 {
		status = "okay";
		#sound-dai-cells = <0>;
		compatible = "everest,es8388", "everest,es8323";
		reg = <0x11>;
		clocks = <&mclkout_i2s0>;
		clock-names = "mclk";
		assigned-clocks = <&mclkout_i2s0>;
		assigned-clock-rates = <12288000>;
		pinctrl-names = "default";
		pinctrl-0 = <&i2s0_mclk>;
	};
};

/* Enable I2S0 */
&i2s0_8ch {
	status = "okay";
	rockchip,trcm-sync-tx-only;
	pinctrl-0 = <&i2s0_lrck
			 &i2s0_sclk
			 &i2s0_sdi0
			 &i2s0_sdo0>;
};

/* Enable SARADC */
&saradc {
	status = "okay";
	vref-supply = <&avcc_1v8_s0>;
};

/* Enable TSADC */
&tsadc {
	status = "okay";
};

/* eMMC interface */
&sdhci {
	bus-width = <8>;
	no-sdio;
	no-sd;
	non-removable;
	max-frequency = <200000000>;
	mmc-hs400-1_8v;
	mmc-hs400-enhanced-strobe;
	full-pwr-cycle-in-suspend;
	status = "okay";
};

/* SD/TF card interface */
&sdmmc {
	max-frequency = <200000000>;
	no-sdio;
	no-mmc;
	bus-width = <4>;
	cap-mmc-highspeed;
	cap-sd-highspeed;
	disable-wp;
	sd-uhs-sdr104;
	vmmc-supply = <&vcc_3v3_sd_s3>;
	vqmmc-supply = <&vccio_sd_s0>;
	pinctrl-names = "default";
	pinctrl-0 = <&sdmmc_bus4 &sdmmc_clk &sdmmc_cmd &sdmmc_det>;
	status = "okay";
};

/* Enable IEP */
&iep {
	status = "okay";
};

/* Enable IEP MMU */
&iep_mmu {
	status = "okay";
};

/* Enable JPEG decoder */
&jpegd {
	status = "okay";
};

/* Enable JPEG decoder MMU */
&jpegd_mmu {
	status = "okay";
};

/* Enable JPEG encoder CCU */
&jpege_ccu {
	status = "okay";
};

/* Enable JPEG encoder 0 */
&jpege0 {
	status = "okay";
};

&jpege0_mmu {
	status = "okay";
};

/* Enable JPEG encoder 1 */
&jpege1 {
	status = "okay";
};

&jpege1_mmu {
	status = "okay";
};

/* Enable JPEG encoder 2 */
&jpege2 {
	status = "okay";
};

&jpege2_mmu {
	status = "okay";
};

/* Enable JPEG encoder 3 */
&jpege3 {
	status = "okay";
};

&jpege3_mmu {
	status = "okay";
};

/* Enable MPP service */
&mpp_srv {
	status = "okay";
};

/* Enable PWM4 */
&pwm4 {
	pinctrl-0 = <&pwm4m0_pins>;
	status = "okay";
};

/* Enable PWM2 */
&pwm2 {
	pinctrl-0 = <&pwm2m0_pins>;
	status = "okay";
};

/* Enable PWM6 */
&pwm6 {
	pinctrl-0 = <&pwm6m0_pins>;
	status = "okay";
};

/* PWM3 as IR receiver */
&pwm3 {
	compatible = "rockchip,remotectl-pwm";
	pinctrl-names = "default";
	pinctrl-0 = <&pwm3m1_pins>;
	remote_pwm_id = <3>;
	handle_cpu_id = <1>;
	remote_support_psci = <0>;
	status = "okay";

	ir_key_lemonpi{
	rockchip,usercode = <0xff00>;
	rockchip,key_table =
		<0xba   KEY_POWER>,      /* 电源按键 */
		<0xb8   KEY_MENU>,       /* 菜单按键 */
		<0xbc   KEY_BACK>,       /* 返回按键 */
		<0xbb   KEY_HOME>,       /* home键按键 */
		<0xea   KEY_PLAY>,       /* 播放按键 */
		<0xbf   KEY_VOLUMEUP>,   /* 音量加按键 */
		<0xe6   KEY_VOLUMEDOWN>, /* 音量键按键 */
		<0xf6   KEY_FASTFORWARD>,/* 快进按键 */
		<0xf8   KEY_FASTREVERSE>,/* 快退按键 */
		<0xf2   KEY_BACKSPACE>,  /* BaskSpace按键 */
		<0xf3   KEY_1>,          /* 按键1 */
		<0xe7   KEY_2>,
		<0xa1   KEY_3>,
		<0xf7   KEY_4>,
		<0xe3   KEY_5>,
		<0xa5   KEY_6>,
		<0xbd   KEY_7>,
		<0xad   KEY_8>,
		<0xb5   KEY_9>,
		<0xe9   KEY_0>;          /* 按键0 */
	};
};

/* Enable RGA3 core 0 */
&rga3_core0 {
	status = "okay";
};

&rga3_0_mmu {
	status = "okay";
};

/* Enable RGA3 core 1 */
&rga3_core1 {
	status = "okay";
};

&rga3_1_mmu {
	status = "okay";
};

/* Enable RGA2 */
&rga2 {
	status = "okay";
};

/* Enable NPU */
&rknpu {
	rknpu-supply = <&vdd_npu_s0>;
	mem-supply = <&vdd_npu_mem_s0>;
	status = "okay";
};

/* Enable NPU MMU */
&rknpu_mmu {
	status = "okay";
};

/* Enable video decoder CCU */
&rkvdec_ccu {
	status = "okay";
};

/* Enable video decoder 0 */
&rkvdec0 {
	status = "okay";
};

&rkvdec0_mmu {
	status = "okay";
};

/* Enable video decoder 1 */
&rkvdec1 {
	status = "okay";
};

&rkvdec1_mmu {
	status = "okay";
};

/* Enable video encoder CCU */
&rkvenc_ccu {
	status = "okay";
};

/* Enable video encoder 0 */
&rkvenc0 {
	status = "okay";
};

&rkvenc0_mmu {
	status = "okay";
};

/* Enable video encoder 1 */
&rkvenc1 {
	status = "okay";
};

&rkvenc1_mmu {
	status = "okay";
};

/* Enable video tunnel */
&rkvtunnel {
	status = "okay";
};

/* Enable watchdog */
&wdt {
	status = "okay";
};

/* Ethernet MAC 0 */
&gmac0 {
	phy-mode = "rgmii-rxid";
	clock_in_out = "output";
	snps,reset-gpio = <&gpio4 RK_PC6 GPIO_ACTIVE_LOW>;
	snps,reset-active-low;
	snps,reset-delays-us = <0 20000 100000>;
	pinctrl-names = "default";
	pinctrl-0 = <&gmac0_miim
			 &gmac0_tx_bus2
			 &gmac0_rx_bus2
			 &gmac0_rgmii_clk
			 &gmac0_rgmii_bus>;
	tx_delay = <0x20>;
	phy-handle = <&rgmii_phy0>;
	status = "okay";
};

/* Ethernet MAC 1 */
&gmac1 {
	phy-mode = "rgmii-rxid";
	clock_in_out = "output";
	snps,reset-gpio = <&gpio3 RK_PB7 GPIO_ACTIVE_LOW>;
	snps,reset-active-low;
	snps,reset-delays-us = <0 20000 100000>;
	pinctrl-names = "default";
	pinctrl-0 = <&gmac1_miim
			 &gmac1_tx_bus2
			 &gmac1_rx_bus2
			 &gmac1_rgmii_clk
			 &gmac1_rgmii_bus>;
	tx_delay = <0x20>;
	phy-handle = <&rgmii_phy1>;
	status = "okay";
};

/* MDIO0 Bus & PHY */
&mdio0 {
	rgmii_phy0: phy@0 {
		compatible = "ethernet-phy-ieee802.3-c22";
		reg = <0x00>;
		realtek,led-data = <0x6d60>;
	};
};

/* MDIO1 Bus & PHY */
&mdio1 {
	rgmii_phy1: phy@0 {
		compatible = "ethernet-phy-ieee802.3-c22";
		reg = <0x00>;
		realtek,led-data = <0x6d60>;
	};
};

/* PCIe 3.0 PHY */
&pcie30phy {
	rockchip,pcie30-phymode = <PHY_MODE_PCIE_AGGREGATION>;
	status = "okay";
};

/* PCIe 3.0 x4 (M.2 M-Key) */
&pcie3x4 {
	reset-gpios = <&gpio1 RK_PB2 GPIO_ACTIVE_HIGH>;
	vpcie3v3-supply = <&vcc3v3_sys>;
	status = "okay";
};

/* Combo PHY 1 (PCIe/SATA) */
&combphy1_ps {
	status = "okay";
};

/* PCIe 2.0 x1 (M.2 E-Key) */
&pcie2x1l0 {
	reset-gpios = <&gpio4 RK_PA5 GPIO_ACTIVE_HIGH>;
	disable-gpios = <&gpio0 RK_PC6 GPIO_ACTIVE_HIGH>;
	status = "okay";
};

/* Combo PHY 0 (PCIe/SATA) */
&combphy0_ps {
	status = "okay";
};

/* PCIe 2.0 x1 (Mini-PCIe) */
&pcie2x1l2 {
	pinctrl-names = "default";
	pinctrl-0 = <&pcie_disable_pin>;
	reset-gpios = <&gpio3 RK_PD1 GPIO_ACTIVE_HIGH>;
	disable-gpios = <&gpio3 RK_PC1 GPIO_ACTIVE_HIGH>;
	status = "disabled";
};

/* SATA 0 */
&sata0{
	status = "okay";
};

/* USB3/DP Combo PHY 1 */
&usbdp_phy1 {
	status = "okay";
};

&usbdp_phy1_u3 {
	status = "okay";
};

/* USB 3.1 Host */
&usbdrd3_1 {
	status = "okay";
};

&usbdrd_dwc3_1 {
	status = "okay";
	dr_mode = "host";
};

/* USB3/DP Combo PHY 0 (Type-C) */
&usbdp_phy0 {
	orientation-switch;
	svid = <0xff01>;
	sbu1-dc-gpios = <&gpio1 RK_PA0 GPIO_ACTIVE_HIGH>;
	sbu2-dc-gpios = <&gpio1 RK_PA1 GPIO_ACTIVE_HIGH>;
	status = "okay";

	port {
		#address-cells = <1>;
		#size-cells = <0>;
		usbdp_phy0_orientation_switch: endpoint@0 {
			reg = <0>;
			remote-endpoint = <&usbc0_orien_sw>;
		};

		usbdp_phy0_dp_altmode_mux: endpoint@1 {
			reg = <1>;
			remote-endpoint = <&dp_altmode_mux>;
		};
	};
};

&usbdp_phy0_u3 {
	status = "okay";
};

&usbdp_phy0_dp {
	status = "okay";
};

/* USB 3.1 OTG */
&usbdrd3_0 {
	status = "okay";
};

/* USB 3.1 OTG DWC3 core */
&usbdrd_dwc3_0 {
	dr_mode = "otg";
	usb-role-switch;
	status = "okay";
	
	port {
		#address-cells = <1>;
		#size-cells = <0>;
		dwc3_0_role_switch: endpoint@0 {
			reg = <0>;
			remote-endpoint = <&usbc0_role_sw>;
		};
	};
};

/* USB 2.0 PHY 0 (OTG) */
&u2phy0 {
	status = "okay";
};

&u2phy0_otg {
	rockchip,typec-vbus-det;
	status = "okay";
};

/* USB 2.0 PHY 1 (OTG) */
&u2phy1 {
	status = "okay";
};

&u2phy1_otg {
	status = "okay";
};

/* Combo PHY 2 (USB3/SATA/PCIe) */
&combphy2_psu {
	status = "okay";
};

/* USB 3.1 Host 2 */
&usbhost3_0 {
	status = "okay";
};

&usbhost_dwc3_0 {
	dr_mode = "host";
	status = "okay";
};

/* USB 2.0 PHY 2 (Host) */
&u2phy2 {
	status = "okay";
};

&u2phy2_host {
	phy-supply = <&vcc5v0_usb>;
	status = "okay";
};

/* USB 2.0 Host 0 (EHCI) */
&usb_host0_ehci {
	status = "okay";
};

/* USB 2.0 Host 0 (OHCI) */
&usb_host0_ohci {
	status = "okay";
};

/* USB 2.0 PHY 3 (Host) */
&u2phy3 {
	status = "okay";
};

&u2phy3_host {
	phy-supply = <&vcc5v0_usb>;
	status = "okay";
};

/* USB 2.0 Host 1 (EHCI) */
&usb_host1_ehci {
	status = "okay";
};

/* USB 2.0 Host 1 (OHCI) */
&usb_host1_ohci {
	status = "okay";
};

/* VDPU (Video Decode) */
&vdpu {
	status = "okay";
};

&vdpu_mmu {
	status = "okay";
};

/* VEPU (Video Encode) */
&vepu {
	status = "okay";
};

/* DisplayPort 0 output */
&dp0 {
	status = "okay";
};

/* DP0 video routing */
&route_dp0 {
	status = "okay";
	connect = <&vp1_out_dp0>;
};

&dp0_in_vp0 {
	status = "disabled";
};

&dp0_in_vp1 {
	status = "okay";
};

&dp0_in_vp2 {
	status = "disabled";
};

/* VOP (Video Output Processor) */
&vop {
	status = "okay";
	vop-supply = <&vdd_log_s0>;
};

/* VOP MMU */
&vop_mmu {
	status = "okay";
};

/* HDMI receiver */
&hdmirx_ctrler {
	status = "okay";
	#sound-dai-cells = <1>;
	hpd-trigger-level = <1>;
	hdmirx-det-gpios = <&gpio1 RK_PD5 GPIO_ACTIVE_LOW>;
	pinctrl-0 = <&hdmim1_rx_cec &hdmim1_rx_hpdin &hdmim1_rx_scl &hdmim1_rx_sda &hdmirx_det>;
	pinctrl-names = "default";
};

/* Display subsystem */
&display_subsystem {
	clocks = <&hdptxphy_hdmi_clk1>;
	clock-names = "hdmi1_phy_pll";
};

/* HDMI1 TX PHY */
&hdptxphy_hdmi_clk1 {
	status = "okay";
};

/* HDMI1 video routing */
&route_hdmi1{
	status = "okay";
	connect = <&vp0_out_hdmi1>;
};

/* HDMI1 output */
&hdmi1 {
	enable-gpios = <&gpio1 RK_PC6 GPIO_ACTIVE_HIGH>;
	status = "okay";
};

&hdmi1_in_vp0 {
	status = "okay";
};

&hdmi1_in_vp1 {
	status = "disabled";
};

&hdmi1_in_vp2 {
	status = "disabled";
};


/* HDMI-in audio link */
&hdmiin_sound {
	status = "okay";
};

/* I2S7 for HDMI-in audio */
&i2s7_8ch{
	status = "okay";
};

/* Video Plane 0 (for 8K) */
&vp0 {
	rockchip,plane-mask = <(1 << ROCKCHIP_VOP2_CLUSTER0 | 1 << ROCKCHIP_VOP2_ESMART0)>;
	rockchip,primary-plane = <ROCKCHIP_VOP2_ESMART0>;
	// cursor-win-id = <ROCKCHIP_VOP2_CLUSTER0>;
};

/* Video Plane 1 (for 8K) */
&vp1 {
	rockchip,plane-mask = <(1 << ROCKCHIP_VOP2_CLUSTER1 | 1 << ROCKCHIP_VOP2_ESMART1)>;
	rockchip,primary-plane = <ROCKCHIP_VOP2_ESMART1>;
	cursor-win-id = <ROCKCHIP_VOP2_CLUSTER1>;
};

/* Video Plane 2 */
&vp2 {
	rockchip,plane-mask = <(1 << ROCKCHIP_VOP2_CLUSTER2 | 1 << ROCKCHIP_VOP2_ESMART2)>;
	rockchip,primary-plane = <ROCKCHIP_VOP2_ESMART2>;
	cursor-win-id = <ROCKCHIP_VOP2_CLUSTER2>;
};

/* Video Plane 3 */
&vp3 {
	rockchip,plane-mask = <(1 << ROCKCHIP_VOP2_CLUSTER3 | 1 << ROCKCHIP_VOP2_ESMART3)>;
	rockchip,primary-plane = <ROCKCHIP_VOP2_ESMART3>;
	cursor-win-id = <ROCKCHIP_VOP2_CLUSTER3>;
};

/* Pin control hub */
&pinctrl {
	
	/* RTC interrupt pin */
	hym8563 {
		hym8563_int: hym8563-int {
			rockchip,pins = <0 RK_PB0 RK_FUNC_GPIO &pcfg_pull_up>;
		};
	};

	/* Headphone detect pin */
	headphone {
		hp_det: hp-det {
			rockchip,pins = <1 RK_PD3 RK_FUNC_GPIO &pcfg_pull_none>;
		};
	};

	/* Pins for USB Type-C */
	usb-typec {
		fusb302_int: fusb302-int {
			rockchip,pins = <0 RK_PC4 RK_FUNC_GPIO &pcfg_pull_up>;
		};
		typec_vbus_en: typec-vbus-en {
			rockchip,pins = <2 RK_PB5 RK_FUNC_GPIO &pcfg_pull_none>;
		};
	};

	/* System LED pin */
	leds {
		sys_led_pin: sys-led-pin {
			rockchip,pins = <0 RK_PD3 RK_FUNC_GPIO &pcfg_pull_none>;
		};
	};

	/* HDMI-in detect pin */
	hdmirx {
		hdmirx_det: hdmirx-det {
			rockchip,pins = <1 RK_PD5 RK_FUNC_GPIO &pcfg_pull_up>;
		};
	};

	/* IO expander interrupt pins */
	io {
		pinctrl_pca9535_1: pinctrl-pca9535-1 {
			rockchip,pins = <2 RK_PC4 RK_FUNC_GPIO &pcfg_pull_none>;
		};
		pinctrl_pca9535_2: pinctrl-pca9535-2 {
			rockchip,pins = <2 RK_PC5 RK_FUNC_GPIO &pcfg_pull_none>;
		};
	};

	/* PCIe disable pin */
	pcie {
		pcie_disable_pin: pcie-disable-pin{
			rockchip,pins = <3 RK_PC1 RK_FUNC_GPIO &pcfg_pull_up>;
		};
	};
};
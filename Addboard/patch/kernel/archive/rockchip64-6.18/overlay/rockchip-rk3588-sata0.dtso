// SPDX-License-Identifier: (GPL-2.0+ OR MIT)
/dts-v1/;
/plugin/;

/ {
	fragment@0 {
		target = <&pcie2x1l0>;

		__overlay__ {
			status = "disabled";
		};
	};

	fragment@1 {
		target = <&sata0>;

		__overlay__ {
			status = "okay";
		};
	};
};

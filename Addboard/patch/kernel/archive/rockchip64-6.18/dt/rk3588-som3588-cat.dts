// SPDX-License-Identifier: (GPL-2.0+ OR MIT)
/*
 * Copyright (c) 2021 Rockchip Electronics Co., Ltd.
 * Device Tree Source for SOM3588Cat board on Rockchip RK3588 SoC.
 *
 */

#include "rk3588-lemonpi.dts"

/ {
	model = "SOM3588Cat";
	compatible = "rockchip,som3588-cat", "rockchip,rk3588";
};